## smp_svr/boards/arm/alpha3_advanced/Kconfig.board
```kconfig
# BL653 DVK board configuration

# Copyright (c) 2020 Laird Connectivity
# SPDX-License-Identifier: Apache-2.0

config BOARD_ALPHA3_ADVANCED
	bool "ALPHA3 ADVANCED"
	depends on SOC_NRF52833_QIAA
```

## smp_svr/boards/arm/alpha3_advanced/Kconfig.defconfig
```kconfig
# BL653 DVK board configuration

# Copyright (c) 2020 Laird Connectivity
# SPDX-License-Identifier: Apache-2.0

if BOARD_ALPHA3_ADVANCED

config BOARD
	default "alpha3_advanced"

config IEEE802154_NRF5
	default y
	depends on IEEE802154

config BT_CTLR
	default BT


endif # BOARD_ALPHA3_ADVANCED
```

## smp_svr/build/Kconfig/Kconfig.shield
```kconfig
osource "c:/Users/SongDian/Desktop/smp_svr2/smp_svr/boards/shields/*/Kconfig.shield"
osource "c:/Users/SongDian/Desktop/alpha4firmware/hello_world3/boards/shields/*/Kconfig.shield"
osource "C:/Users/SongDian/ncs2/v2.0.2/nrf/boards/shields/*/Kconfig.shield"
```

## smp_svr/build/Kconfig/Kconfig.shield.defconfig
```kconfig
osource "c:/Users/SongDian/Desktop/smp_svr2/smp_svr/boards/shields/*/Kconfig.defconfig"
osource "c:/Users/SongDian/Desktop/alpha4firmware/hello_world3/boards/shields/*/Kconfig.defconfig"
osource "C:/Users/SongDian/ncs2/v2.0.2/nrf/boards/shields/*/Kconfig.defconfig"
```

## standalone_api/drivers/customperipheral/Kconfig
```kconfig
menuconfig CUSTOMPERIPHERAL

    bool "Enable Customperipheral"
    depends on GPIO
    help
      Lorem ipsum dolor sit amet, consectetur adipiscing elit. Nam dignissim et nibh ac ullamcorper. Quisque in elementum turpis. Sed vitae orci elit.


if CUSTOMPERIPHERAL

    module = CUSTOMPERIPHERAL
    module-str = customperipheral
    source "subsys/logging/Kconfig.template.log_config"

endif #CUSTOMPERIPHERAL
```
